## sdkconfig.defaults
```kconfig
# Partition Table
CONFIG_PARTITION_TABLE_CUSTOM=y
CONFIG_PARTITION_TABLE_CUSTOM_FILENAME="partitions.csv"
CONFIG_PARTITION_TABLE_FILENAME="partitions.csv"
CONFIG_PARTITION_TABLE_OFFSET=0x8000
CONFIG_PARTITION_TABLE_MD5=y

# Zigbee Router
CONFIG_ZB_ENABLED=y
CONFIG_ZB_ZCZR=y

# mbedTLS (required for Zigbee security)
CONFIG_MBEDTLS_HARDWARE_AES=n
CONFIG_MBEDTLS_HARDWARE_MPI=n
CONFIG_MBEDTLS_HARDWARE_SHA=n
CONFIG_MBEDTLS_CMAC_C=y
CONFIG_MBEDTLS_SSL_PROTO_DTLS=y
CONFIG_MBEDTLS_KEY_EXCHANGE_ECJPAKE=y
CONFIG_MBEDTLS_ECJPAKE_C=y

# ESP32-C6 specifics
CONFIG_ESP_DEFAULT_CPU_FREQ_MHZ_160=y

# Flash: 4MB
CONFIG_ESPTOOLPY_FLASHSIZE_4MB=y

# Bootloader rollback support for OTA
CONFIG_BOOTLOADER_APP_ROLLBACK_ENABLE=y

# Disable secondary USB serial console (blocks Zigbee on single-core C6)
CONFIG_ESP_CONSOLE_SECONDARY_NONE=y

# FreeRTOS: 1ms tick for responsive Zigbee scheduling (default 100Hz is too coarse)
CONFIG_FREERTOS_HZ=1000

# IEEE 802.15.4 radio timing optimization (recommended by Espressif for Zigbee)
CONFIG_IEEE802154_TIMING_OPTIMIZATION=y

# Reduce log level to avoid stalling
CONFIG_LOG_DEFAULT_LEVEL_WARN=y
```
